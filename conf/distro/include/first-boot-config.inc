## conf/distro/include/first-boot-config.inc
```bitbake
FIRST_BOOT_CERT_FILE = "/etc/ssl/certs/server.crt"
FIRST_BOOT_KEY_FILE = "/etc/ssl/private/server.key"
```

## conf/layer.conf
```bitbake
BBPATH .= ":${LAYERDIR}"
BBFILES += "${LAYERDIR}/recipes-*/*/*.bb ${LAYERDIR}/recipes-*/*/*.bbappend"
BBFILE_COLLECTIONS += "bottazzi"
BBFILE_PATTERN_bottazzi = "^${LAYERDIR}/"
BBFILE_PRIORITY_bottazzi = "10"
LAYERSERIES_COMPAT_bottazzi = "scarthgap"

LAYERDEPENDS_bottazzi = "meta-tailscale"
```
